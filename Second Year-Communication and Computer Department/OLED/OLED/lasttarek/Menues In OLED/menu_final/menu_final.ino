#include "U8g2lib.h"

U8G2_SSD1306_128X64_NONAME_F_HW_I2C u8g2(U8G2_R0); // [full framebuffer, size = 1024 bytes]
// icons 16x16
const unsigned char bitmap_barv [] PROGMEM = {
  0x00, 0x00, 0x00, 0x00, 0x00, 0x00, 0x00, 0x00, 0x01, 0xc0, 0x01, 0xf0, 0x01, 0xf0, 0x07, 0xf0, 
  0x07, 0xf0, 0x37, 0xf0, 0x37, 0xf0, 0x37, 0xf0, 0x37, 0xf0, 0x36, 0xf0, 0x00, 0x00, 0x00, 0x00};  


const unsigned char bitmap_barh [] PROGMEM = {
  0x80, 0x00, 0x80, 0x00, 0xbe, 0x00, 0xbe, 0x00, 0x80, 0x00, 0xbf, 0xc0, 0xbf, 0xc0, 0x80, 0x00, 
  0xbf, 0xf8, 0xbf, 0xf8, 0x80, 0x00, 0xbf, 0xff, 0xbf, 0xff, 0x80, 0x00, 0x92, 0x48, 0xff, 0xff};
const unsigned char bitmap_dial [] PROGMEM = {
  0xE0, 0x07, 0x18, 0x18, 0x84, 0x24, 0x0A, 0x40, 0x12, 0x50, 0x21, 0x80, 
  0xC1, 0x81, 0x45, 0xA2, 0x41, 0x82, 0x81, 0x81, 0x05, 0xA0, 0x02, 0x40, 
  0xD2, 0x4B, 0xC4, 0x23, 0x18, 0x18, 0xE0, 0x07, };
const unsigned char bitmap_chart [] PROGMEM = {
  0x80, 0x01, 0x80, 0x00, 0x80, 0x02, 0x80, 0x04, 0x80, 0x04, 0x80, 0x08, 0x80, 0xc8, 0x80, 0x30, 
  0x81, 0x00, 0x82, 0x00, 0x80, 0x00, 0x9c, 0x00, 0x80, 0x00, 0xa0, 0x00, 0x80, 0x00, 0xff, 0xff};



const unsigned char* bitmap_icons[4] = {
  bitmap_barv,
  bitmap_barh,
  bitmap_dial,
  bitmap_chart,
};



// images 128x64
const unsigned char bitmap_Barv [] PROGMEM = {
  0xff, 0xff, 0xff, 0xff, 0xff, 0xff, 0xff, 0xff, 0xff, 0xff, 0xff, 0xff, 0xff, 0xff, 0xff, 0xff, 
  0xff, 0xff, 0xff, 0xff, 0xff, 0xff, 0xff, 0xff, 0xff, 0xff, 0xff, 0xff, 0xff, 0xff, 0xff, 0xff, 
  0xff, 0xff, 0xff, 0xff, 0xff, 0xff, 0xff, 0xff, 0xff, 0xff, 0xff, 0xff, 0xff, 0xff, 0xff, 0xff, 
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  0xff, 0xff, 0xff, 0xff, 0xff, 0xff, 0xff, 0xff, 0xff, 0xff, 0xff, 0xff, 0xff, 0xff, 0xff, 0xff};

const unsigned char bitmap_Barh [] PROGMEM = {
  0xff, 0xff, 0xff, 0xff, 0x0f, 0xff, 0xff, 0xff, 0xff, 0xff, 0xff, 0xff, 0xff, 0xff, 0xff, 0xff, 
  0xff, 0xff, 0xff, 0xff, 0x0f, 0xff, 0xff, 0xff, 0xff, 0xff, 0xff, 0xff, 0xff, 0xff, 0xff, 0xff, 
  0xff, 0xff, 0xff, 0xff, 0x0f, 0xff, 0xff, 0xff, 0xff, 0xff, 0xff, 0xff, 0xff, 0xff, 0xff, 0xff, 
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  0xff, 0xff, 0xff, 0xff, 0x00, 0x00, 0x00, 0x00, 0x00, 0x00, 0x00, 0x00, 0xff, 0xff, 0xff, 0xff };

const unsigned char bitmap_Dial [] PROGMEM = {
  0x00, 0x00, 0x03, 0xff, 0xff, 0xff, 0xff, 0xff, 0xff, 0xff, 0xff, 0xff, 0xff, 0x80, 0x00, 0x00, 
  0x00, 0x00, 0x03, 0xff, 0xff, 0xff, 0xfd, 0xf7, 0xdf, 0xff, 0xff, 0xff, 0xff, 0x80, 0x00, 0x00, 
  0x00, 0x00, 0x03, 0xff, 0xff, 0xff, 0xbd, 0xf7, 0xde, 0xff, 0xff, 0xff, 0xff, 0x80, 0x00, 0x00, 
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  0x00, 0x00, 0x03, 0xff, 0xef, 0xff, 0xff, 0xff, 0xff, 0xff, 0xfb, 0xff, 0xff, 0x80, 0x00, 0x00};

const unsigned char bitmap_Chart [] PROGMEM = {
  0xff, 0xff, 0xff, 0xff, 0x3f, 0xff, 0xff, 0xff, 0xff, 0xff, 0xff, 0xfc, 0xff, 0xff, 0xff, 0xff, 
  0xff, 0xff, 0xff, 0xff, 0x1f, 0xff, 0xff, 0xff, 0xff, 0xff, 0xff, 0xf8, 0xff, 0xff, 0xff, 0xff, 
  0xff, 0xff, 0xff, 0xff, 0x1f, 0xff, 0xff, 0xff, 0xff, 0xff, 0xff, 0xf0, 0xff, 0xff, 0xff, 0xff, 
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  0xff, 0xff, 0xff, 0xff, 0x00, 0x00, 0x00, 0x00, 0x00, 0x00, 0x00, 0x00, 0xff, 0xff, 0xff, 0xff};

 

const unsigned char* bitmap_images[4] = {
  bitmap_Barv,
  bitmap_Barh,
  bitmap_Dial, 
  bitmap_Chart,
};

//8x64px
const unsigned char bitmap_scrollbar [] PROGMEM = {
  0x00, 0x40, 0x00, 0x40, 0x00, 0x40, 0x00, 0x40, 0x00, 0x40, 0x00, 0x40, 
  0x00, 0x40, 0x00, 0x40, 0x00, 0x40, 0x00, 0x40, 0x00, 0x40, 0x00, 0x40, 
  0x00, 0x40, 0x00, 0x40, 0x00, 0x40, 0x00, 0x40, 0x00, 0x40, 0x00, 0x40, 
  0x00, 0x40, 0x00, 0x40, 0x00, 0x40, 0x00, 0x40, 0x00, 0x40, 0x00, 0x40, 
  0x00, 0x40, 0x00, 0x40, 0x00, 0x40, 0x00, 0x40, 0x00, 0x40, 0x00, 0x40, 
  0x00, 0x40, 0x00, 0x00, };


//128x21p
const unsigned char bitmap_item_sel_outline [] PROGMEM = {
  0xF8, 0xFF, 0xFF, 0xFF, 0xFF, 0xFF, 0xFF, 0xFF, 0xFF, 0xFF, 0xFF, 0xFF, 
  0xFF, 0xFF, 0xFF, 0x03, 0x04, 0x00, 0x00, 0x00, 0x00, 0x00, 0x00, 0x00, 
  0x00, 0x00, 0x00, 0x00, 0x00, 0x00, 0x00, 0x04, 0x02, 0x00, 0x00, 0x00, 
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  0xFF, 0xFF, 0xFF, 0xFF, 0xFF, 0xFF, 0xFF, 0xFF, 0xFF, 0xFF, 0xFF, 0x03, 
};

const int NUM_ITEMS = 4;
 const int MAX_ITEM_LENGTH = 20; 
//item name
char menu_items [NUM_ITEMS] [MAX_ITEM_LENGTH] = {  
  { "Vertical Bar" }, 
  { "Horizontal Bar" }, 
  { "Dial" }, 
  { "x-y Chart" }, 
 };

#define BUTTON_UP_PIN 12 
#define BUTTON_SELECT_PIN 8 
#define BUTTON_DOWN_PIN 4 

int button_up_clicked = 0; 
int button_select_clicked = 0; 
int button_down_clicked = 0;

int item_selected = 0; 

int item_sel_previous; 
int item_sel_next; 

int current_screen = 0;   // 0 = menu, 1 = images

void setup() {
  u8g2.begin();

  
  // INPUT_PULLUP means the button is HIGH when not pressed, and LOW when pressed
  pinMode(BUTTON_UP_PIN, INPUT_PULLUP); 
  pinMode(BUTTON_SELECT_PIN, INPUT_PULLUP); 
  pinMode(BUTTON_DOWN_PIN, INPUT_PULLUP); 
}


void loop() {
  if (current_screen == 0) { 
      // up and down buttons only work for the menu screen
      if ((digitalRead(BUTTON_UP_PIN) == LOW) && (button_up_clicked == 0)) { 
        item_selected = item_selected - 1; 
        button_up_clicked = 1; 
        if (item_selected < 0) { 
          item_selected = NUM_ITEMS-1;
        }
      }
      else if ((digitalRead(BUTTON_DOWN_PIN) == LOW) && (button_down_clicked == 0)) { 
        item_selected = item_selected + 1; 
        button_down_clicked = 1; 
        if (item_selected >= NUM_ITEMS) {
          item_selected = 0;
          }
      } 

      if ((digitalRead(BUTTON_UP_PIN) == HIGH) && (button_up_clicked == 1)) { 
        button_up_clicked = 0;
      }
      if ((digitalRead(BUTTON_DOWN_PIN) == HIGH) && (button_down_clicked == 1)) { 
        button_down_clicked = 0;
      }

  }


  if ((digitalRead(BUTTON_SELECT_PIN) == LOW) && (button_select_clicked == 0)) { 
     button_select_clicked = 1; 
     if (current_screen == 0) {current_screen = 1;} 
     else {current_screen = 0;}
  }
  if ((digitalRead(BUTTON_SELECT_PIN) == HIGH) && (button_select_clicked == 1)) { 
    button_select_clicked = 0;
  }

  item_sel_previous = item_selected - 1;
  if (item_sel_previous < 0) {item_sel_previous = NUM_ITEMS - 1;} 
  item_sel_next = item_selected + 1;  
  if (item_sel_next >= NUM_ITEMS) {item_sel_next = 0;} 



  u8g2.clearBuffer();  
    if (current_screen == 0) { 

      u8g2.drawXBMP(0, 22, 128, 21, bitmap_item_sel_outline);

      // draw previous 
      u8g2.setFont(u8g_font_7x14);
      u8g2.drawStr(25, 15, menu_items[item_sel_previous]); 
      u8g2.drawXBMP( 4, 2, 16, 16, bitmap_icons[item_sel_previous]);          

      // draw selected 
      u8g2.setFont(u8g_font_7x14B);    
      u8g2.drawStr(25, 15+20+2, menu_items[item_selected]);   
      u8g2.drawXBMP( 4, 24, 16, 16, bitmap_icons[item_selected]);     

      // draw next 
      u8g2.setFont(u8g_font_7x14);     
      u8g2.drawStr(25, 15+20+20+2+2, menu_items[item_sel_next]);   
      u8g2.drawXBMP( 4, 46, 16, 16, bitmap_icons[item_sel_next]);  

      // draw scrollbar 
      u8g2.drawXBMP(128-8, 0, 8, 64, bitmap_scrollbar);

      // draw scrollbar 
      u8g2.drawBox(125, 64/NUM_ITEMS * item_selected, 3, 64/NUM_ITEMS);                

    } 
//images
    else if (current_screen == 1) { 
        // u8g2.setColorIndex(0);
        //draw images
        u8g2.drawXBMP( 0, 0, 128, 64, bitmap_images[item_selected]); 
        // u8g2.setColorIndex(1);

    }   
  u8g2.sendBuffer(); // send buffer from RAM to display 


}
